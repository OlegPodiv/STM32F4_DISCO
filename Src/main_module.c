/*
Основной модуль, реализующий
алгоритм управления.

*/
//******************************************************************************
// Секция include: здесь подключается заголовочный файл к модулю
//******************************************************************************
//#include "stdint.h"
//#include "stdio.h"
#include "cmsis_os.h"
#include "main.h"
#include "global_var.h"
#include "main_module.h"
//******************************************************************************
// Секция определения переменных, используемых в модуле
//******************************************************************************
//------------------------------------------------------------------------------
// Глобальные
//------------------------------------------------------------------------------
extern uint8_t NumberUartConsole;
extern T_SENSORS sensors;
extern T_BOILER_STATE boiler;
extern T_BOILER_STATE last_boiler;
extern T_MENU_TEMPERATURE temperatures;
extern T_MENU_TIME times;
extern T_MENU_SEASON season;
extern T_BIN_OUTPUTS binout;
extern T_EVENT on_off;
extern T_EVENT ext_event;
extern T_EVENT last_event;

extern osTimerId BurnerAugerTimerHandle;
extern osTimerId DebounceTimerHandle;
extern osTimerId HopperAugerTimerHandle;
extern osTimerId AutoCleanTimerHandle;
extern osTimerId AshRemoveTimerHandle;
extern osTimerId HotWaterPumpTimerHandle;
extern osTimerId Aux1TimerHandle;
extern osTimerId CirclePumpTimerHandle;
extern osTimerId IgnitionTimerHandle;
extern osTimerId BurnerFanTimerHandle;
extern osTimerId SecondaryAirFanTimerHandle;
extern osTimerId SuctionFanTimerHandle;

extern osTimerId CleanTimerHandle;
extern osTimerId AshCleanTimerHandle;
//------------------------------------------------------------------------------
// Локальные
//------------------------------------------------------------------------------
//static uint32_t turn_off_count = 0;
//static uint32_t start_ready_count = 0;
//static uint32_t self_test_count = 0;
static uint32_t ignition_count = 0;
static uint32_t stabilization_count = 0;
static uint32_t work_count = 0;
static uint32_t maintain_count = 0;
static uint32_t wait_count = 0;
static uint32_t block_count = 0;
static uint32_t crash_count = 0;

static uint32_t first_ignition_count = 0; // счетчик секунд основного розжига 
static uint32_t second_ignition_count = 0; // счетчик секунд повторного розжига 
//******************************************************************************
// Секция прототипов локальных функций
//******************************************************************************
// Функции, отрабатыватываемые в соответствующих состояниях котла
void boiler_turn_off(void);
void boiler_start_ready(void);
void boiler_self_test(void);
void boiler_ignition(void);
void boiler_stabilization(void);
void boiler_work(void);
void boiler_maintain(void);
void boiler_wait(void);
void boiler_block(void);
void boiler_crash(void);
// -----------------------------------------------------------------------------------------
void main_function_ignition(void);
void main_function_stabilization(void);
void main_function_work(void);
void main_function_maintain(void);
void main_function_wait(void);
void main_function_block(void);
void main_function_crash(void);
// --------------------- Авария по температуре топливоподачи -------------------------------	
void FuelTemperatureAlarm(void);
// --------------------- Низкий уровень топлива --------------------------------------------
void FuelLevelAlarm(void);
// --------------------- Авария по термостату безопасности котла ---------------------------
void BoilerSafetyThermostatAlarm(void);
// --------------------- Предупреждение по комнатному термостату ---------------------------
void RoomThermostatAlarm(void);
// --------------------- Авария по внешлему сигналу А1 ---------------------------
void A1Alarm(void);
// -------------- Останов всех таймеров ---------------------------------------------------
void AllTimersStop(void);
// ----------------- Выкл всех управляемых устройств --------------------------------------
void All_Off(void);
// ------------------ Тушение горелки -----------------------------------------------------
void ExtinguishBurner(void);
//******************************************************************************
// Секция описания функций (сначала глобальных, потом локальных)
//******************************************************************************
// ----------------------------------------------------

void boiler_init(void)
{
	boiler = START_READY_STATE;
	last_boiler = boiler_state_load_eeprom();	
binout.AlarmDry.enable = 1;
binout.AlarmDry.GPIOx = Relay_9_GPIO_Port;
binout.AlarmDry.GPIO_Pin = Relay_9_Pin;
binout.AlarmDry.PinStateActive = GPIO_PIN_SET;	
// -----------------------------------------------------------
binout.AshRemove.enable = 1;
binout.AshRemove.GPIOx = Relay_6_GPIO_Port;
binout.AshRemove.GPIO_Pin = Relay_6_Pin;
binout.AshRemove.PinStateActive = GPIO_PIN_SET;	
// -----------------------------------------------------------	
binout.AutoClean.enable = 1;
binout.AutoClean.GPIOx = Relay_5_GPIO_Port;
binout.AutoClean.GPIO_Pin = Relay_5_Pin;
binout.AutoClean.PinStateActive = GPIO_PIN_SET;	
// -----------------------------------------------------------	
binout.Aux1.enable = 1;
binout.Aux1.GPIOx = Relay_2_GPIO_Port;
binout.Aux1.GPIO_Pin = Relay_2_Pin;
binout.Aux1.PinStateActive = GPIO_PIN_SET;	
// -----------------------------------------------------------	
binout.Aux2.enable = 0;
binout.Aux2.GPIOx = Relay_0_GPIO_Port;
binout.Aux2.GPIO_Pin = Relay_0_Pin;
binout.Aux2.PinStateActive = GPIO_PIN_SET;
// -----------------------------------------------------------	
binout.BurnerAuger.enable = 1;
binout.BurnerAuger.GPIOx = Relay_1_GPIO_Port;
binout.BurnerAuger.GPIO_Pin = Relay_1_Pin;
binout.BurnerAuger.PinStateActive = GPIO_PIN_SET;
// -----------------------------------------------------------	
binout.CirclePump.enable = 1;
binout.CirclePump.GPIOx = Relay_7_GPIO_Port;
binout.CirclePump.GPIO_Pin = Relay_7_Pin;
binout.CirclePump.PinStateActive = GPIO_PIN_SET;
// -----------------------------------------------------------	
binout.FireSafetyValve.enable = 1;
binout.FireSafetyValve.GPIOx = Relay_8_GPIO_Port;
binout.FireSafetyValve.GPIO_Pin = Relay_8_Pin;
binout.FireSafetyValve.PinStateActive = GPIO_PIN_SET;
// -----------------------------------------------------------	
binout.HopperAuger.enable = 1;
binout.HopperAuger.GPIOx = Relay_0_GPIO_Port;
binout.HopperAuger.GPIO_Pin = Relay_0_Pin;
binout.HopperAuger.PinStateActive = GPIO_PIN_SET;
// ------------------------------------------------------------
binout.HotWaterPump.enable = 1;
binout.HotWaterPump.GPIOx = Relay_3_GPIO_Port;
binout.HotWaterPump.GPIO_Pin = Relay_3_Pin;
binout.HotWaterPump.PinStateActive = GPIO_PIN_SET;
// ------------------------------------------------------------
binout.Ignition.enable = 1;
binout.Ignition.GPIOx = Relay_4_GPIO_Port;
binout.Ignition.GPIO_Pin = Relay_4_Pin;
binout.Ignition.PinStateActive = GPIO_PIN_SET;
// ------------------------------------------------------------
  
}	
// ----------------Котел ШАГ-----------------------------------
void boiler_step(void)
{
	switch(boiler)
	{
		
		case TURNED_OFF_STATE:			// состояние "Выключено"
		{	last_boiler = boiler_state_load_eeprom();	
			boiler_state_save_eeprom(TURNED_OFF_STATE);
			boiler_turn_off();
			break;}
// -----------------------------------------------------------------	
case START_READY_STATE:			// состояние "Готов к включению"
		{ last_boiler = boiler_state_load_eeprom();	
			boiler_state_save_eeprom(START_READY_STATE);
			boiler_start_ready();
			break;}
// -----------------------------------------------------------------		
		case SELF_TEST_STATE:				// состояние "Самотестирование"
		{	last_boiler = boiler_state_load_eeprom();	
			boiler_state_save_eeprom(SELF_TEST_STATE);
			boiler_self_test();
			break;}
// -----------------------------------------------------------------		
		case IGNITION_STATE:			// состояние "Розжиг"
		{	last_boiler = boiler_state_load_eeprom();	
			boiler_state_save_eeprom(IGNITION_STATE);
			boiler_ignition();
			break;}
// -----------------------------------------------------------------		
		case STABILIZATION_STATE:		// состояние "Стабилизация"
		{	last_boiler = boiler_state_load_eeprom();	
			boiler_state_save_eeprom(STABILIZATION_STATE);
			boiler_stabilization();
			break;}
// -----------------------------------------------------------------		
		case WORKING_STATE:					// состояние "Рабочий"
		{	last_boiler = boiler_state_load_eeprom();	
			boiler_state_save_eeprom(WORKING_STATE);
			boiler_work();
			break;}
// -----------------------------------------------------------------		
		case MAINTAINING_STATE:			// состояние "Поддержание"
		{	last_boiler = boiler_state_load_eeprom();	
			boiler_state_save_eeprom(MAINTAINING_STATE);
			boiler_maintain();
			break;}
// -----------------------------------------------------------------		
		case WAITING_STATE:					// состояние "Ожидание"
		{	last_boiler = boiler_state_load_eeprom();	
			boiler_state_save_eeprom(WAITING_STATE);
			boiler_wait();
			break;}
// -----------------------------------------------------------------		
		case BLOCKING_STATE:				// состояние "Блокировка"
		{	last_boiler = boiler_state_load_eeprom();	
			boiler_state_save_eeprom(BLOCKING_STATE);
			boiler_block();
			break;}
// -----------------------------------------------------------------		
		case CRASH_STATE:						// состояние "Авария"	
		{	last_boiler = boiler_state_load_eeprom();	
			boiler_state_save_eeprom(CRASH_STATE);
			boiler_crash();
			break;}
// -----------------------------------------------------------------		
	}
}	
// ---------------- Конец котел шаг --------------------------------------

// ----------- Функция обработки состояния "Совсем выключено" ---------------------------------- 
void boiler_turn_off(void)
{
All_Off();
osTimerStop(CleanTimerHandle);
osTimerStop(AshCleanTimerHandle);		
//AllTimersStop();	
// Условия перехода "Совсем выключено" --> "Готов к включению"	
/*
	Нажатие кнопки ON - 5 сек. 
*/
if (on_off == ON_EVENT) boiler = START_READY_STATE; // 5 c
}
// ---------------------------------------------------------------------------------------------	
// ----------- Функция обработки состояния "Котел готов к включению" ---------------------------
void boiler_start_ready(void)
{
All_Off();
osTimerStop(CleanTimerHandle);
osTimerStop(AshCleanTimerHandle);	
//AllTimersStop();	
// ========================================================================================================================================
//	Условия перехода "Готов к включению" в "Совсем выключено"
/*
	Нажатие кнопки ON - 5 сек. 
*/
if (on_off == OFF_EVENT) boiler = TURNED_OFF_STATE;	// 5 c
// ========================================================================================================================================
//	Условия перехода "Готов к включению" в "Готов к включению"
/*
Переход из состояния выключено в выключено – Котел находится перманентно, постоянно проверяя свое состояние по датчикам:
Д1 – датчик аварийной температуры топливоподачи, в случае срабатывания(размыкания  контакта биметаллической пластины), 
котел отрабатывает протокол безопасности от возгорания в бункере.  Так же следует информирование диспетчера, оператора, 
владельца котла о возникновении аварийной ситуации и срабатывании протокола безопасности по ДАТТ. По завершению работы 
протокола безопасности по ДАТТ, следует оповещение вышеперечисленных лиц о нормализации работы системы и перехода котла в 
состояние выключено. В пакет информации должны входить так же данные с установленных на котле датчиков, таких как температура 
теплоносителя, дымовых газов и т.д. Так же возникновение аварийной ситуации прописывается в лог ошибок, с указанием даты и 
времени начала и завершения аварийного события. Срабатывание механизмов протокола безопасности.
Д3 – Датчик температуры теплоносителя в подаче, в случае превышения температуры теплоносителя граничных(к примеру заданной как 110*С). 
В случае превышения температуры по верхнему пределу - следует информирование диспетчера, оператора, владельца котла о возникновении 
аварийной ситуации. В пакет информации должны входить так же данные с установленных на котле датчиков, таких как температура 
теплоносителя, дымовых газов и т.д. Кроме этого происходит следующее:

- открывается на большой круг трехходовой клапан ,
- включение насоса ГВС  
- включение магистрального насоса
- Блокировка включения вентиляторов.

В случае понижения температуры теплоносителя ниже установленной и изменяемой границы(к примеру +5*С). Следует отработка протокола «АнтиФриз».
Так же следует информирование диспетчера, оператора, владельца котла о возникновении аварийной ситуации и срабатывании протокола безопасности 
по АнтиФриз. По завершению работы протокола безопасности по АнтиФриз, следует оповещение вышеперечисленных лиц о нормализации работы системы и 
перехода котла в состояние выключено. В пакет информации должны входить так же данные с установленных на котле датчиков, таких как температура 
теплоносителя, дымовых газов и т.д. Так же возникновение аварийной ситуации прописывается в лог ошибок, с указанием даты и времени начала и 
завершения аварийного события. Срабатывание механизмов протокола безопасности.
Д4 – Капиллярный термостат безопасности котла, Случае срабатывания, размыкания контакта капилярного датчика 
при превышении теплоносителем температуры уставки :

-открывается на большой круг трехходовой клапан ,
- включение насоса ГВС  
- включение магистрального насоса
- Блокировка включения вентиляторов.

Следует информирование диспетчера, оператора, владельца котла о возникновении аварийной ситуации. В пакет информации должны входить так же 
данные с установленных на котле датчиков, таких как температура теплоносителя, дымовых газов и т.д.
Так же возникновение аварийной ситуации прописывается в лог ошибок, с указанием даты и времени начала и завершения аварийного события. 
Срабатывание механизмов протокола безопасности. При возвращении к нормальному состоянию, происходит оповещение оператора и соответствующая 
запись в логе о времени окончания события. Д6 – Датчик Температуры ГВС, при превышении температуры ГВС установленных граничных значений 
(например максимально возможная температура ГВС 75*с, а на деле достигла уже 90*С), то котел предпринимает следующие действия:

1.	Сравнивает температуру в Бойлере, с температурой в котле. 
2.	Если температура в котле ниже чем в бойлере, то включает насос  ГВС.
3.	Открывает трехходовой клапан и включает циркуляционный насос, сбрасывая избыточное тепло в систему отопления.

Действие данного протокола, в случае его запуска имеет свои временные пределы и допуски по температура ГВС и отопления.
В обязательном порядке происходит информирование диспетчера, оператора, владельца котла о возникновении аварийной ситуации. 
В пакет информации должны входить так же данные с установленных на котле датчиков, таких как температура теплоносителя, дымовых газов и т.д.
Так же возникновение аварийной ситуации прописывается в лог ошибок, с указанием даты и времени начала и завершения аварийного события. 
Срабатывание механизмов протокола безопасности. При возвращении к нормальному состоянию, происходит оповещение оператора и соответствующая 
запись в логе о времени окончания события.

Д8 – датчик комнатного термостата,  В случае если функция «Комнатный Термостат» активна, но котел был выключен с панели управления, 
то включение никаких исполнительных механизмов невозможно. При инициации запуска комнатным термостатом происходит однократное 
информирование оператора или ответственного лица о снижении температуры по комнатному термостату ниже установленного значения, 
но невозможности запуска из-за ручного отключения котла. Д10 – Датчик температуры отходящих газов, При превышении температуры отходящих 
газов граничных значений, котел должен:
Произвести информирование диспетчера, оператора, владельца котла о возникновении аварийной ситуации. В пакет информации должны входить так же 
данные с установленных на котле датчиков, таких как температура теплоносителя, дымовых газов и т.д.
Так же возникновение аварийной ситуации прописывается в лог ошибок, с указанием даты и времени начала и завершения аварийного события. 
Срабатывание механизмов протокола безопасности. При возвращении к нормальному состоянию, происходит оповещение оператора и соответствующая 
запись в логе о времени окончания события.

А1 – При получении сиганала о внешней аварии, котел должен:
информирование диспетчера, оператора, владельца котла о возникновении аварийной ситуации. В пакет информации должны входить так же данные с 
установленных на котле датчиков, таких как температура теплоносителя, дымовых газов и т.д.
Так же возникновение аварийной ситуации прописывается в лог ошибок, с указанием даты и времени начала и завершения аварийного события. 
Срабатывание механизмов протокола безопасности. При возвращении к нормальному состоянию, происходит оповещение оператора и соответствующая 
запись в логе о времени окончания события.

*/
// =====================================================================================================================================================
// Условия перехода "Готов к включению --> "Самотестирование"
/*
Из состояния выключено в состояние самопроверка котел может перейти в следующих случаях:
1.	Нажата клавиша включения
2.	Получена команда старт
3.	Восстановление работоспособности после потери эл.питания.
*/
	if ((on_off == ON_EVENT)||(ext_event == START_EVENT)) boiler = SELF_TEST_STATE;		
// ======================================================================================================================================================
// Условия перехода "Готов к включению --> "Розжиг"
// Условия перехода "Готов к включению --> "Стабилизация"
// Условия перехода "Готов к включению --> "Рабочий"
// Условия перехода "Готов к включению --> "Поддержание"
// Условия перехода "Готов к включению --> "Ожидание"
// Условия перехода "Готов к включению --> "Блокировка"
//    Н И К О Г Д А
// ======================================================================================================================================================
// Условия перехода "Готов к включению --> "Авария"
/*
Из состояния выключено в состояние авария котел переходит в следующих случаях:
1.	Д1 – Аварийная температура топливоподачи – при размыкании короткозамкнутого контакта ДАТТ
2.	Д2 – Датчик уровня топлива в бункере – при размыкании контакта
3.	Д3 – Датчик температуры теплоносителя подачи – при превышении граничного значения 
4.	Д4 – Капиллярный термостат безопасности котла – размыкание котороткозамкнутого контакта капиллярного датчика.
5.	Д6 – Датчик температуры ГВС – превышение установленного граничного значения по ГВС
6.	Д10 – Датчик температуры отходящих газов – превышение установленного граничного значения по отходящим газам
7.	А1 – Внешняя авария – размыкание короткозамкнутого контакта, получение сигнала авария

(D1!=0)|(D2!=0)|(D3>D3_max)|(D4!=0)|(D6>D6_max)|(D10>D10_max)|(A1!=0)
*/
	if ((sensors.D1!=0)||(sensors.D2!=0)||(sensors.D3>temperatures.D3_max)||(sensors.D4!=0)||(sensors.D6>temperatures.D6_max)
		||(sensors.D10>temperatures.D10_max)||(sensors.A1!=0)) boiler = CRASH_STATE;

}
// ====================================================================================================================================================== 
// ----------- Функция обработки состояния "Самотестирование" ----------------------------------
void boiler_self_test(void)
{
// ======================================================================================================================================================	
// Условия перехода "Самотестирование" --> "Готов к включению"
/*
Из состояния самопроверка в состояние выключено котел переходит в следующих случаях:
1.	Нажата клавиша Выкл.
2.	Получена команда СТОП
3.	Получена команда внешняя авария
4.	Получен сигнал о размыкании нормально замкнутого контакта датчика Д8(комнатный термостат). 
При условии, что выбрана опция работы по комнатному термостату и выбран режим работы ВКЛ-ВЫКЛ.

*/	
	if ((on_off==OFF_EVENT)||(sensors.A1!=0)||(sensors.D8!=0)) boiler = START_READY_STATE;
// ======================================================================================================================================================
// Условия перехода "Самотестирование" --> "Самотестирование"
//    Н И К О Г Д А
// ======================================================================================================================================================
// Условия перехода "Самотестирование" --> "Розжиг"
/*
Из состояния самопроверка в состояние розжиг котел переходит в следующих случаях:
1.	Д3 – Датчик температуры теплоносителя подачи – при условии, что температура 
		теплоносителя не достигла заданного значения D3_target, а температура дымовых газов по датчику Д10 ниже установленного значения D10_ignition
	
2.	Д6 - Датчик температуры ГВС – при условии, что температура ГВС не достигла заданного значения D6_target а 
		температура дымовых газов по датчику Д10 ниже установленного значения D10_ignition
	
3.	Д8 – контакты датчика комнатного термостата замкнуты, функция работы по датчику комнатного термостат активна, температура дымовых 
		газов по датчику Д10 ниже установленного значения D10_ignition, температура теплоносителя по датчику Д3 не достигла заданного значения D3_target 
		и температура ГВС по датчику Д6 не достигла заданного значения D6_target
	
4.	Д10 - Датчик температуры отходящих газов – при условии, что температура дымовых газов не достигла значения D10_ignition, температура теплоносителя 
		по датчику Д3 не достигла заданного значения D3_target и температура ГВС по датчику Д6 не достигла заданного значения D6_target
	
(D3<D3_target)&(D10<D10_ignition)&(D6<D6_target)&(D8=0)&(A1=0)
*/	
	if ((sensors.D3<temperatures.D3_target)&&(sensors.D10<temperatures.D10_ignition)&&(sensors.D6<temperatures.D6_target)
			&&(sensors.D8 == 0)&&(sensors.A1 == 0)) boiler = IGNITION_STATE;
// ======================================================================================================================================================	
// Условия перехода "Самотестирование" --> "Стабилизация"
/*
Из состояния самопроверка в состояние стабилизация, котел переходит в следующих случаях:
1.	Д10 – Температура отходящих газов находится в диапазоне выше заданного значения перехода в стабилизацию  D10_ignition, 
		но ниже чем заданная температура перехода в рабочий режим D10_work, а температура теплоносителя по датчику Д3 ниже 
		установленного значения D3_target 
		и\или температура ГВС по датчику Д6 ниже заданного значения D6_target, 
		в случае активной функции поддержания температуры ГВС

(D10_ignition<D10<D10_work)&(D3<D3_target)&(D6<D6_target)&(D8=0)&(A1=0)
*/	
	if ((sensors.D10>temperatures.D10_ignition)&&(sensors.D10<temperatures.D10_work)&&(sensors.D3<temperatures.D3_target)
			&&(sensors.D6<temperatures.D6_target)&&(sensors.D8 == 0)&&(sensors.A1 == 0)) boiler = STABILIZATION_STATE;
// ======================================================================================================================================================
// Условия перехода "Самотестирование" --> "Рабочий"
/*
Из состояния самопроверки в состояние Рабочий котел переходит в следующих случаях:
1.	Д10 – температура дымовых газов достигла значения перехода в рабочий режим D10_work, но не выше граничных 
					значений для перехода в поддержание D10_maintain или в блокировку D10_max
2.	Д3 – температура теплоносителя не достигла заданного значения D3_target
3.	Д6 – температура ГВС не достигла заданного значения D6_target
4.	Д8 – комнатный термостат – нормально замкнутый контакт замкнут, в случае если функция активна.
5.	А1 – внешняя авария – нормально замкнутый контакт замкнут и не получена команда о внешней аварии.

(D10_work<=D10<D10_maintain)&(D10<D10_max)&(D3<D3_target)&(D6<D6_target)&(D8=0)&(A1=0)
*/	
	if ((sensors.D10>=temperatures.D10_work)&&(sensors.D10<temperatures.D10_maintain)&&(sensors.D10<temperatures.D10_max)
		&&(sensors.D3<temperatures.D3_target)&&(sensors.D6<temperatures.D6_target)&&(sensors.D8 == 0)&&(sensors.A1 == 0))	boiler = WORKING_STATE;
// ======================================================================================================================================================	
// Условия перехода "Самотестирование" --> "Поддержание"
/*
	Из состояния самопроверки в состояние Поддержание котел переходит в следующих случаях:
1.	Д3 – температура теплоносителя  достигла заданного значения D3_target, но не достигла значения  
		представляющей из себя значение D3_target+D01(гистерезис).
2.	Д6 – Температура ГВС  достигла заданного значения D6_target, если выбрана функция работы только по ГВС. 
		Если же активна и функция отопления, то проверяется еще и показания Датчика Д3 на соответствие D3_target. Учитывается датчик Д8.
	
3.	Д8 – Датчик комнатный термостат, если активная функция комнатный термостат и выбран режим его работы – 
		«Рабочий-поддержание», то при размыкании короткозамкнутого контакта, котел уходит в поддержание.
	
4.	Д10 – Датчик температуры дымовых газов – при достижении граничного значения D10_maintain переводит котел в режим поддержания, 
		вне зависимости от показания Д3, Д6 и Д8
	
5.	Внешняя команда – в случае получения команды от БУ БМК или другой системы диспетчеризации о принудительном переводе котла в режим поддержание горения.

((D3_target<=D3<D3_target+D01)&(D6>=D6_target)&(D8=0)&(A1=0))|(D10 >= D10_maintain)	
*/	
	if (((sensors.D3>=temperatures.D3_target)&&(sensors.D3<(temperatures.D3_target+temperatures.D01))&&(sensors.D6>=temperatures.D6_target)&&(sensors.D8 == 0)&&(sensors.A1 == 0))
		||(sensors.D10 >= temperatures.D10_maintain)) boiler = MAINTAINING_STATE;
// ======================================================================================================================================================
//  Условия перехода "Самотестирование" --> "Ожидание"
/*
Из состояния Самопроверка в состояние Ожидание, котел переходит в следующих случаях:
1.	Д3 – Датчик температуры теплоносителя подачи, в случае если  температура теплоносителя достигла величины D3_target+D01
2.	Д6 – Датчик температуры ГВС, в случае если температура ГВС достигла значения D6_target и выбран режим ЛЕТО. Если выбран режим ЗИМА, то при достижении температуры ГВС значения D6_target 
		отключается только насос ГВС, а в режим ожидания выходит когда и температура ГВС достигает заданного значения D6_target  , и температура теплоносителя достигла D3_target+D01
3.	Д8 – Комнатный термостат – если активна функция комнатный термостат, при выбранном  режиме ЗИМА , то при достижении температуры ГВС значения D6_target отключается только насос ГВС, 
		а в режим ожидания выходит когда и температура теплоносителя достигает заданного значения D3_target+В01,  и короткозамкнутый контакт датчика Д8 – замкнут.
4.	Д10 – Показания датчика отслеживаются, но не учитываются.
5.	Внешняя команда – при получении команды от БУ БМК или других источников диспетчеризации о переводе котла в режим ожидание.

(D3>=(D3_target+D01))&(D6>=D6_target)&(D8=0)&(A1=0)// NB!
*/	
	if ((sensors.D3>=(temperatures.D3_target+temperatures.D01))&&(sensors.D6>=temperatures.D6_target)&&(sensors.D8 == 0)&&(sensors.A1 == 0)) boiler = WAITING_STATE; // NB!
// ======================================================================================================================================================	
//  Условия перехода "Самотестирование" --> "Блокировка"
/*
			Никогда
*/
// ======================================================================================================================================================	
//  Условия перехода "Самотестирование" --> "Авария"
/*
Из состояния Самопроверки в состояние Авария котел переходит в следующих случаях:
1.	Д1 - датчик аварийной температуры топливоподачи – при размыкании короткозамкнутого контакта 
2.	Д2 – датчик уровня топлива в бункере. Размыкание контакта при активной функции, после выдержки времени Т1
3.	Д3 – датчик аварийной температуры теплоносителя. Превышения температуры теплоносителя в подаче выше установленного 
		граничного значения D3_max
4.	Д4 – Капиллярный термостат безопасности котла – При размыкании короткозамкнутого контакта
5.	Д6 – Датчик температуры ГВС – При превышении температуры ГВС установленного граничного значения D6_max
6.	Д10 – Датчик температуры дымовых газов – При превышении граничного значения D10_max
7.	А1 – Внешняя авария – При получении сигнала внешняя авария от БУ БМК или других средств диспетчеризации, при размыкании контакта Внешняя авария.

(D1!=0)|(D2!=0)|(D3>D3_max)|(D4!=0)|(D6>D6_max)|(D10>D10_max)|(A1!=0)
*/
if ((sensors.D1 != 0)||(sensors.D2 != 0)||(sensors.D3 > temperatures.D3_max)||(sensors.D4 != 0)||(sensors.D6 > temperatures.D6_max)||(sensors.D10 > temperatures.D10_max)
	||(sensors.A1 != 0)) boiler = CRASH_STATE;
}
// ======================================================================================================================================================	
// ------------- Функция обработки состояния "Розжиг"
void boiler_ignition(void)
{
//NumberUartConsole = 2;	
//printf("%u", times.T06);	
// ======================================================================================================================================================
// Условия перехода "Розжиг" --> "Готов к включению"
/*
Из состояния Розжиг в состояние Выключено котел может перейти в следующих случаях:
1.	Д8 – Датчик комнатный термостат – размыкание короткозамкнутого контакта
2.	ВЫКЛ – нажатие клавиши выключение и удержание ее в течении 5 сек
3.	СТОП – получение команды стоп
4.	ПП – потеря электропитания – переводите котел в состояние выключено, 
	до момента восстановления  эл. питания.
*/
if ((on_off == OFF_EVENT)||(ext_event == STOP_EVENT)||(sensors.D8 != 0)) boiler = START_READY_STATE;	
// ======================================================================================================================================================	
// Условия перехода "Розжиг" --> "Самотестирование"
/*
					Н И К О Г Д А
*/
// ======================================================================================================================================================	
// Условия перехода "Розжиг" --> "Розжиг"
/*
Из состояния Розжиг в состояние Розжиг котел переходит в следующих случаях:
1.	Т2 – временной интервал для основного розжига – если в течении времени Т2(Т05 в техзадании)температура отходящих газов не достигла значения  D10_min, 
		то включается алгоритм повторного разжига, который имеет свои настройки, отличные от настроек первичного розжига и свое время работы 
		(Т08 в техзадании)
	
*/
// ======================================================================================================================================================
// Условия перехода "Розжиг" --> "Стабилизация"
/*
Из состояния розжиг в состояние стабилизация котел переходит в следующих случаях:
1.	Д3 – Датчик температуры теплоносителя не достиг значения D3_target
2.	Д6 – Датчик температуры ГВС не достиг значения D6_target
3.	Д10 – Датчик температуры отходящих газов достиг значения D10_ignition, но не достиг значения D10_work

(D3<D3_target)&(D6<D6_target)&(D10_ignition<=D10<D10_work)
*/
if ((sensors.D3 < temperatures.D3_target)&&(sensors.D6 < temperatures.D6_target)&&(sensors.D10 >= temperatures.D10_ignition)
	&&(sensors.D10 < temperatures.D10_work)) boiler = STABILIZATION_STATE;
// ======================================================================================================================================================
// Условия перехода "Розжиг" --> "Рабочий"
/*
Из состояния розжиг в состояние Рабочий котел переходит в следующих случаях:

1.	Д10 – температура дымовых газов достигла значения перехода в рабочий режим D10_work, 
		но не выше граничных значений для перехода в поддержание D10_maintain или в блокировку D10_max
2.	Д3 – температура теплоносителя не достигла заданного значения D3_target
3.	Д6 – температура ГВС не достигла заданного значения D6_target
4.	Д8 – комнатный термостат – нормально замкнутый контакт замкнут, в случае если функция активна.
5.	А1 – внешняя авария – нормально замкнутый контакт замкнут и не получена команда о внешней аварии.

(D10_work<=D10<D10_maintain)&(D10<D10_max)&(D3<D3_target)&(D6<D6_target)&(D8=0)&(A1=0)
*/
if ((sensors.D10 >= temperatures.D10_work)&&(sensors.D10 < temperatures.D10_maintain)&&(sensors.D10 < temperatures.D10_max)
		&&(sensors.D3 < temperatures.D3_target)&&(sensors.D6 < temperatures.D6_target)&&(sensors.D8 == 0)&&(sensors.A1 == 0)) boiler = WORKING_STATE;
// ======================================================================================================================================================
// Условия перехода "Розжиг" --> "Поддержание"
/*
Из состояния розжиг в состояние Поддержание котел переходит в следующих случаях:

1.	Д3 – температура теплоносителя  достигла заданного значения D3_target, но не достигла значения D3_target+D01(гистерезис).
2.	Д6 – Температура ГВС  достигла заданного значения D6_target, если выбрана функция работы только по ГВС. Если же активна и функция отопления, 
		то проверя.тся еще и показания Датчика Д3 на соответствие D3_target. Учитывается датчик Д8.
3.	Д8 – Датчик комнатный термостат, если активная функция комнатный термостат и выбран режим его работы – «Рабочий-поддержание», 
		то при размыкании короткозамкнутого контакта, котел уходит в поддержание. При условии, что температура по датчику Д10
4.	Д10 – Датчик температуры дымовых газов – при достижении граничного значения D10_maintain переводит котел в режим поддержания, вне зависимости от показания Д3, Д6 и Д8
5.	Внешняя команда – в случае получения команды от БУ БМК или другой системы диспетчеризации о принудительном переводе котла в режим поддержание горения.

((D3_target<=D3<D3_target+D01)&(D6>=D6_target)&(D8 != 0))||(D10>=D10_maintain))
*/
if (((sensors.D3 >= temperatures.D3_target)&&(sensors.D3 < temperatures.D3_target+temperatures.D01)&&(sensors.D6 >= temperatures.D6_target)
		&&(sensors.D8 != 0))||(sensors.D10 >= temperatures.D10_maintain)) boiler = MAINTAINING_STATE;
// =======================================================================================================================================================
// Условия перехода "Розжиг" --> "Ожидание"
/*
Из состояния розжиг в состояние Ожидание  котел переходит в следующих случаях:
1.	Д3 – температура теплоносителя  достигла заданного значения D3_target, но не достигла значения D3_target+D01(гистерезис).
2.	Д6 – Температура ГВС  достигла заданного значения D6_target, если выбрана функция работы только по ГВС. Если же активна и функция отопления, 
		то проверяется еще и показания Датчика Д3 на соответствие D3_target. Учитывается датчик Д8.
3.	Д8 – Датчик комнатный термостат, если активная функция комнатный термостат и выбран режим его работы – «Рабочий-Ожидание», 
		то при размыкании короткозамкнутого контакта, котел уходит в поддержание. При условии, что температура по датчику Д10
4.	Д10 – Датчик температуры дымовых газов – не ниже температуры удавшегося розжига  D10_ignition
5.	Внешняя команда – в случае получения команды от БУ БМК или другой системы диспетчеризации о принудительном переводе котла в режим поддержание горения.

((D3_target<=D3<D3_target+D01)&(D6>=D6_target))|(D10>=D10_ignition))
*/
if (((sensors.D3 >= temperatures.D3_target)&&(sensors.D3 < temperatures.D3_target+temperatures.D01)&&(sensors.D6 >= temperatures.D6_target))
		||(sensors.D10 >= temperatures.D10_ignition)) boiler = WAITING_STATE;
// =======================================================================================================================================================
// Условия перехода "Розжиг" --> "Блокировка"
/*
					Никогда
*/
// =======================================================================================================================================================
// Условия перехода "Розжиг" --> "Авария"	
/*
Из состояния розжиг в состояние Авария котел переходит в следующих случаях:
Д1, Д2,Д3,Д4,Д6,Д10,А1
8.	Д1 - датчик аварийной температуры топливоподачи – при размыкании короткозамкнутого контакта 
9.  Д2 – датчик уровня топлива в бункере. Размыкание контакта при активной функции, после выдержки времени Т1
10.	Д3 – датчик аварийной температуры теплоносителя. Превышения температуры теплоносителя в подаче выше установленного граничного значения D3_max
11.	Д4 – Капиллярный термостат безопасности котла – При размыкании короткозамкнутого контакта
12.	Д6 – Датчик температуры ГВС – При превышении температуры ГВС установленного граничного значения D6_max
13.	Д10 – Датчик температуры дымовых газов – При превышении граничного значения D10_max
14.	А1 – Внешняя авария – При получении сигнала внешняя авария от БУ БМК или других средств диспетчеризации, при размыкании контакта Внешняя авария.

(D1!=0)|(D2!=0)|(D3>D3_max)|(D4!=0)|(D6>D6_max)|(D10>D10_max)|(A1!=0)
*/
if ((sensors.D1 != 0)||(sensors.D2 != 0)||(sensors.D3 > temperatures.D3_max)||(sensors.D4 != 0)
		||(sensors.D6 > temperatures.D6_max)||(sensors.D10 > temperatures.D10_max)||(sensors.A1 != 0)) boiler = CRASH_STATE;
// =======================================================================================================================================================
main_function_ignition();
}
// ---------------------------------------------------------------------------------------------	
// ------------- Функция обработки  состояние "Стабилизация"
void boiler_stabilization(void)
{
//NumberUartConsole = 2;	
//printf("tD10igni= %5.f \r\n", temperatures.D10_ignition);		
//printf("tD10stab= %5.f \r\n", temperatures.D10_work);
//printf("tD3targ= %5.f \r\n", temperatures.D3_target);
//printf("tD6targ= %5.f \r\n", temperatures.D6_target);	
// =======================================================================================================================================================
// Условия перехода "Стабилизация" --> "Готов к включению"
/*
Д8, ВЫКЛ, СТОП, ПП
Из состояния Стабилизация в состояние Выключено котел может перейти в следующих случаях:
1.	Д8 – Датчик комнатный термостат – размыкание короткозамкнутого контакта
2.	ВЫКЛ – нажатие клавиши выключение и удержание ее в течении 5 сек
3.	СТОП – получение команды стоп
4.	ПП – потеря электропитания – переводите котел в состояние выключено, до момента восстановления  эл. питания.
*/
if ((on_off == OFF_EVENT)||(ext_event == STOP_EVENT)||(sensors.D8 != 0)) boiler = START_READY_STATE;		
// ========================================================================================================================================================
// Условия перехода "Стабилизация" --> "Самотестирование"
// Условия перехода "Стабилизация" --> "Розжиг"
// Условия перехода "Стабилизация" --> "Стабилизация"
/*
					Н И К О Г Д А
*/
// ========================================================================================================================================================
// Условия перехода "Стабилизация" --> "Рабочий"
/*
Д3,Д6,Д10
Из состояния Стабилизация  в состояние Рабочий  котел переходит в следующих случаях:
1.	Д10 – температура дымовых газов достигла значения перехода в рабочий режим D10_work, 
		но не выше граничных значений для перехода в поддержание D10_maintain или в блокировку D10_max
2.	Д3 – температура теплоносителя не достигла заданного значения D3_target
3.	Д6 – температура ГВС не достигла заданного значения D6_target
4.	Д8 – комнатный термостат – нормально замкнутый контакт замкнут, в случае если функция активна.
5.	А1 – внешняя авария – нормально замкнутый контакт замкнут и не получена команда о внешней аварии.

(D10_work<=D10<D10_maintain)&(D10<D10_max)&(D3<D3_target)&(D6<D6_target)&(D8=0)&(A1=0)
*/
if ((sensors.D10 >= temperatures.D10_work)&&(sensors.D10 < temperatures.D10_maintain)&&(sensors.D10 < temperatures.D10_max)
		&&(sensors.D3 < temperatures.D3_target)&&(sensors.D6 < temperatures.D6_target)&&(sensors.D8 == 0)&&(sensors.A1 == 0)) boiler = WORKING_STATE;
// ========================================================================================================================================================
// Условия перехода "Стабилизация" --> "Поддержание"
/*
Д3,Д6,Д10
Из состояния Стабилизация  в состояние Поддержание котел переходит в следующих случаях:
1.	Д3 – температура теплоносителя  достигла заданного значения D3_target, но не достигла значения  D3_target+D01(гистерезис).
2.	Д6 – Температура ГВС  достигла заданного значения D6_target, если выбрана функция работы только по ГВС. 
		Если же активна и функция отопления, то проверяется еще и показания Датчика Д3 на соответствие D3_target. Учитывается датчик Д8.
3.	Д8 – Датчик комнатный термостат, если активная функция комнатный термостат и выбран режим его работы – «Рабочий-поддержание», 
		то при размыкании короткозамкнутого контакта, котел уходит в поддержание. При условии, что температура по датчику Д10
4.	Д10 – Датчик температуры дымовых газов – при достижении граничного значения D10_maintain переводит котел в режим поддержания, 
		вне зависимости от показания Д3, Д6 и Д8
5.	Внешняя команда – в случае получения команды от БУ БМК или другой системы диспетчеризации о принудительном переводе котла 
 	в режим поддержание горения.

(D3_target<=D3<D3_target+D01)&(D6>=D6_target)&(D8!=0))|(D10>=D10_maintain))
*/
if (((sensors.D3 >= temperatures.D3_target)&&(sensors.D3 < temperatures.D3_target+temperatures.D01)&&(sensors.D6 >= temperatures.D6_target)
		&&(sensors.D8 != 0))||(sensors.D10 >= temperatures.D10_maintain)) boiler = MAINTAINING_STATE;
// =========================================================================================================================================================
// Условия перехода "Стабилизация" --> "Ожидание"
/*
Д3,Д6,Д10
Из состояния Стабилизация  в состояние Ожидание  котел переходит в следующих случаях:
1.	Д3 – температура теплоносителя  достигла значения  D3_target+D01(гистерезис).
2.	Д6 – Температура ГВС  достигла заданного значения D6_target, если выбрана функция работы только по ГВС. 
		Если же активна и функция отопления, то проверяется еще и показания Датчика Д3 на соответствие D3_target. 
		Учитывается датчик Д8.
3.	Д8 – Датчик комнатный термостат, если активная функция комнатный термостат и выбран режим его работы – 
		«Рабочий-Ожидание», то при размыкании короткозамкнутого контакта, котел уходит в поддержание. 
		При условии, что температура по датчику Д10
4.	Д10 – Датчик температуры дымовых газов – не ниже температуры удавшегося розжига  D10_ignition
5.	Внешняя команда – в случае получения команды от БУ БМК или другой системы диспетчеризации о 
		принудительном переводе котла в режим поддержание горения.

(D3>=D3_target+D01)&(D6>=D6_target)&(D8=0)&(D10>=D10_ignition)
*/
if ((sensors.D3 >= temperatures.D3_target+temperatures.D01)&&(sensors.D6 >= temperatures.D6_target)&&(sensors.D8 == 0)
		&&(sensors.D10 >= temperatures.D10_ignition)) boiler = WAITING_STATE;
// ==========================================================================================================================================================
// Условия перехода "Стабилизация" --> "Блокировка"
/*
			НИКОГДА
*/
// ==========================================================================================================================================================
// Условия перехода "Стабилизация" --> "Авария"
/*
Д1, Д2,Д3,Д4,Д6,Д10,А1
Из состояния розжиг в состояние Авария котел переходит в следующих случаях:
15.	Д1 - датчик аварийной температуры топливоподачи – при размыкании короткозамкнутого контакта 
16. Д2 – датчик уровня топлива в бункере. Размыкание контакта при активной функции, после выдержки времени Т1
17.	Д3 – датчик аварийной температуры теплоносителя. Превышения температуры теплоносителя в подаче выше установленного граничного значения D3_max
18.	Д4 – Капиллярный термостат безопасности котла – При размыкании короткозамкнутого контакта
19.	Д6 – Датчик температуры ГВС – При превышении температуры ГВС установленного граничного значения D6_max
20.	Д10 – Датчик температуры дымовых газов – При превышении граничного значения D10_max
21.	А1 – Внешняя авария – При получении сигнала внешняя авария от БУ БМК или других средств диспетчеризации, при размыкании контакта Внешняя авария.

(D1!=0)|(D2!=0)|(D3>D3_max)|(D4!=0)|(D6>D6_max)|(D10>D10_max)|(D10<D10_min)|(A1!=0)
*/
if ((sensors.D1 != 0)||(sensors.D2 != 0)||(sensors.D3 > temperatures.D3_max)||(sensors.D4 != 0)||(sensors.D10<temperatures.D10_min)
		||(sensors.D6 > temperatures.D6_max)||(sensors.D10 > temperatures.D10_max)||(sensors.A1 != 0)) boiler = CRASH_STATE;
// ==========================================================================================================================================================
 main_function_stabilization();
}
// ---------------------------------------------------------------------------------------------	
// ------------- Функция обработки состояние "Рабочий"
void boiler_work(void)
{
// ==========================================================================================================================================================
// Условия перехода "Рабочий" --> "Готов к включению"
/*
Из состояния Рабочий  в состояние Выключено котел может перейти в следующих случаях:
1.	Д8 – Датчик комнатный термостат – размыкание короткозамкнутого контакта
2.	ВЫКЛ – нажатие клавиши выключение и удержание ее в течении 5 сек
3.	СТОП – получение команды стоп
4.	ПП – потеря электропитания – переводите котел в состояние выключено, до момента восстановления  эл. питания.
*/
if ((on_off == OFF_EVENT)||(ext_event == STOP_EVENT)||(sensors.D8 != 0)) boiler = START_READY_STATE;	
// ==========================================================================================================================================================	
// Условия перехода "Рабочий" --> "Самотестирование"
// Условия перехода "Рабочий" --> "Розжиг"
/*
						Н И К О Г Д А
*/
// ==========================================================================================================================================================	
// Условия перехода "Рабочий" --> "Стабилизация"
/*
				???
*/
// ==========================================================================================================================================================	
// Условия перехода "Рабочий" --> "Рабочий"	
/*
							Разделение по мощностям
*/
// ==========================================================================================================================================================
// Условия перехода "Рабочий" --> "Поддержание"
/*
Из состояния Рабочий  в состояние Поддержание котел переходит в следующих случаях:

1.	Д3 – температура теплоносителя  достигла заданного значения D3_target, но не достигла значения  D3_target+D01(гистерезис).
2.	Д6 – Температура ГВС  достигла заданного значения D6_target, если выбрана функция работы только по ГВС. 
		Если же активна и функция отопления, то проверяется еще и показания Датчика Д3 на соответствие D3_target. Учитывается датчик Д8.
3.	Д8 – Датчик комнатный термостат, если активная функция комнатный термостат и выбран режим его работы – «Рабочий-поддержание», 
		то при размыкании короткозамкнутого контакта, котел уходит в поддержание. При условии, что температура Д10 не ниже температуры 
		удавшегося розжига D10_ignition
4.	Д10 – Датчик температуры дымовых газов – при достижении граничного значения D10_maintain переводит котел в режим поддержания, вне зависимости
		от показания Д3, Д6 и Д8
5.	Внешняя команда – в случае получения команды от БУ БМК или другой системы диспетчеризации о принудительном переводе котла в режим 
		поддержание горения.

((D3_target<=D3<D3_target+D01)&(D6>=D6_target)&(D8!=0))|(D10>=D10_maintain))
*/
if (((sensors.D3 >= temperatures.D3_target)&&(sensors.D3 < temperatures.D3_target+temperatures.D01)&&(sensors.D6 >= temperatures.D6_target)
		&&(sensors.D8 != 0))||(sensors.D10 >= temperatures.D10_maintain)) boiler = MAINTAINING_STATE;
// ===========================================================================================================================================================
// Условия перехода "Рабочий" --> "Ожидание"
/*
Д3,Д6,Д10
Из состояния Рабочий  в состояние Ожидание  котел переходит в следующих случаях:
6.	Д3 – температура теплоносителя  достигла значения  D3_target+D01(гистерезис).
7.	Д6 – Температура ГВС  достигла заданного значения D6_target, если выбрана функция работы только по ГВС. 
		Если же активна и функция отопления, то проверяется еще и показания Датчика Д3 на соответствие D3_target. 
		Учитывается датчик Д8.
8.	Д8 – Датчик комнатный термостат, если активная функция комнатный термостат и выбран режим его работы – «Рабочий-Ожидание», 
		то при размыкании короткозамкнутого контакта, котел уходит в поддержание. При условии, что температура по датчику Д10
9.	Д10 – Датчик температуры дымовых газов – не ниже температуры удавшегося розжига  D10_ignition
10.	Внешняя команда – в случае получения команды от БУ БМК или другой системы диспетчеризации о принудительном переводе 
		котла в режим поддержание горения.

(D3>=D3_target+D01)&(D6>=D6_target)&(D8=0)&(D10>=D10_ignition)
*/
if ((sensors.D3 >= temperatures.D3_target+temperatures.D01)&&(sensors.D6 >= temperatures.D6_target)&&(sensors.D8 == 0)
		&&(sensors.D10 >= temperatures.D10_ignition)) boiler = WAITING_STATE;
// ===========================================================================================================================================================
// Условия перехода "Рабочий" --> "Блокировка"
/*
					Никогда
*/ 
// ===========================================================================================================================================================
// Условия перехода "Рабочий" --> "Авария"
/*
Д1, Д2,Д3,Д4,Д6,Д10,А1
Из состояния Рабочий  в состояние Авария котел переходит в следующих случаях:
22.	Д1 - датчик аварийной температуры топливоподачи – при размыкании короткозамкнутого контакта 
23.	 Д2 – датчик уровня топлива в бункере. Размыкание контакта при активной функции, после выдержки времени Т1
24.	Д3 – датчик аварийной температуры теплоносителя. Превышения температуры теплоносителя в подаче выше установленного граничного значения D3_max
25.	Д4 – Капиллярный термостат безопасности котла – При размыкании короткозамкнутого контакта
26.	Д6 – Датчик температуры ГВС – При превышении температуры ГВС установленного граничного значения D6_max
27.	Д10 – Датчик температуры дымовых газов – При превышении граничного значения D10_max
28.	А1 – Внешняя авария – При получении сигнала внешняя авария от БУ БМК или других средств диспетчеризации, при размыкании контакта Внешняя авария.

(D1!=0)|(D2!=0)|(D3>D3_max)|(D4!=0)|(D6>D6_max)|(D10>D10_max)||(D10<D10_min)|(A1!=0)
*/
if ((sensors.D1 != 0)||(sensors.D2 != 0)||(sensors.D3 > temperatures.D3_max)||(sensors.D4 != 0)||(sensors.D10<temperatures.D10_ignition)
		||(sensors.D6 > temperatures.D6_max)||(sensors.D10 > temperatures.D10_max)||(sensors.A1 != 0)) boiler = CRASH_STATE;
// ===========================================================================================================================================================
main_function_work();
}
// ---------------------------------------------------------------------------------------------	
// ------------- Функция обработки состояния "Поддержание"
void boiler_maintain(void)
{
// ============================================================================================================================================================
// Условия перехода "Поддержание" --> "Готов к включению"
/*
Из состояния Поддержание в состояние Выключено котел может перейти в следующих случаях:
1.	Д8 – Датчик комнатный термостат – размыкание короткозамкнутого контакта, если выбрано «Рабочий-Выключено»
2.	ВЫКЛ – нажатие клавиши выключение и удержание ее в течении 5 сек
3.	СТОП – получение команды стоп
4.	ПП – потеря электропитания – переводите котел в состояние выключено, до момента восстановления  эл. питания
*/
if ((on_off == OFF_EVENT)||(ext_event == STOP_EVENT)||(sensors.D8 != 0)) boiler = START_READY_STATE;		
// ============================================================================================================================================================	
// Условия перехода "Поддержание" --> "Самотестирование"
// Условия перехода "Поддержание" --> "Розжиг"
/*
									Н И К О Г Д А	
*/
// ============================================================================================================================================================	
// Условия перехода "Поддержание" --> "Стабилизация"
/*
				???
*/
// ============================================================================================================================================================	
// Условия перехода "Поддержание" --> "Рабочий"	
/*
Из состояния Поддержание  в состояние Рабочий  котел переходит в следующих случаях:
6.	Д10 – температура дымовых газов выше  значения перехода в рабочий режим D10_work, но не выше граничных значений 
		для перехода в поддержание D10_maintain  или в блокировку D10_max
7.	Д3 – температура теплоносителя опустилась ниже высчитываемого значения D3_target-D01
8.	Д6 – температура ГВС опустилась ниже высчитываемого значения D6_target-D04
9.	Д8 – комнатный термостат – нормально замкнутый контакт замкнут, в случае если функция активна. 
		Вне зависимости от выбранной модели «Рабочий-Выключение» или «Рабочий-Поддержание»
10.	А1 – внешняя авария – нормально замкнутый контакт замкнут и не получена команда о внешней аварии.

(D10_work<=D10<D10_maintain)&(D10<D10_max)&(D3<D3_target-D01)&(D6<D6_target-D04)&(D8=0)&(A1=0)
*/
if ((sensors.D10 >= temperatures.D10_work)&&(sensors.D10 < temperatures.D10_maintain)&&(sensors.D10 < temperatures.D10_max)
		&&(sensors.D3 < temperatures.D3_target-temperatures.D01)&&(sensors.D6 < temperatures.D6_target-temperatures.D04)
		&&(sensors.D8 == 0)&&(sensors.A1 == 0)) boiler = WORKING_STATE;
// ============================================================================================================================================================
// Условия перехода "Поддержание" --> "Поддержание"
/*
Из состояния Поддержание  в состояние Поддержание котел переходит в следующих случаях:

6.	Д3 – температура теплоносителя  достигла заданного значения D3_target, но не достигла значения  D3_target+D01(гистерезис).
7.	Д6 – Температура ГВС  достигла заданного значения D6_target, если выбрана функция работы только по ГВС. Если же активна и 
		функция отопления, то проверяется еще и показания Датчика Д3 на соответствие D3_target. Учитывается датчик Д8.
8.	Д8 – Датчик комнатный термостат, если активная функция комнатный термостат и выбран режим его работы – «Рабочий-поддержание», 
		то при размыкании короткозамкнутого контакта, котел уходит в поддержание. При условии, что температура Д10 не ниже температуры удавшегося розжига D10_ignition
9.	Д10 – Датчик температуры дымовых газов – при достижении граничного значения D10_maintain переводит котел в режим поддержания, вне зависимости от показания Д3, Д6 и Д8
10.	Внешняя команда – в случае получения команды от БУ БМК или другой системы диспетчеризации о принудительном переводе котла в режим поддержание горения.

((D3>=D3_target)&(D3<D3_target+D01)&(D6>=D6_target)&(D8!=0))|(D10>=D10_maintain)
*/
if (((sensors.D3 >= temperatures.D3_target)&&(sensors.D3 < temperatures.D3_target+temperatures.D01)&&(sensors.D6 >= temperatures.D6_target)
		&&(sensors.D8 != 0))||(sensors.D10 >= temperatures.D10_maintain)) boiler = MAINTAINING_STATE;
// ============================================================================================================================================================
// Условия перехода "Поддержание" --> "Ожидание"
/*
Д3,Д6,Д10
Из состояния Поддержание  в состояние Ожидание  котел переходит в следующих случаях:
11.	Д3 – температура теплоносителя  достигла значения  D3_target+D01(гистерезис).
12.	Д6 – Температура ГВС  достигла заданного значения D6_target, если выбрана функция работы только по ГВС. 
		Если же активна и функция отопления, то проверяется еще и показания Датчика Д3 на соответствие D3_target. Учитывается датчик Д8.
13.	Д8 – Датчик комнатный термостат, если активная функция комнатный термостат и выбран режим его работы – «Рабочий-Ожидание», 
		то при размыкании короткозамкнутого контакта, котел уходит в поддержание. При условии, что температура по датчику Д10
14.	Д10 – Датчик температуры дымовых газов – не ниже температуры удавшегося розжига  D10_ignition
15.	Внешняя команда – в случае получения команды от БУ БМК или другой системы диспетчеризации о 
		принудительном переводе котла в режим поддержание горения.

(D3>=D3_target+D01)&(D6>=D6_target)&(D8=0)&(D10>=D10_ignition)
*/
if ((sensors.D3 >= temperatures.D3_target+temperatures.D01)&&(sensors.D6 >= temperatures.D6_target)&&(sensors.D8 == 0)
		&&(sensors.D10 >= temperatures.D10_ignition)) boiler = WAITING_STATE;
// ============================================================================================================================================================
// Условия перехода "Поддержание" --> "Блокировка"
/*
				Никогда
*/

// ============================================================================================================================================================
// Условия перехода "Поддержание" --> "Авария"
/*
Д1, Д2,Д3,Д4,Д6,Д10,А1
Из состояния Поддержание в состояние Авария котел переходит в следующих случаях:
1.	Д1 - датчик аварийной температуры топливоподачи – при размыкании короткозамкнутого контакта 
2.	 Д2 – датчик уровня топлива в бункере. Размыкание контакта при активной функции, после выдержки времени Т1
3.	Д3 – датчик аварийной температуры теплоносителя. Превышения температуры теплоносителя в подаче выше установленного граничного значения D3_max
4.	Д4 – Капиллярный термостат безопасности котла – При размыкании короткозамкнутого контакта
5.	Д6 – Датчик температуры ГВС – При превышении температуры ГВС установленного граничного значения D6_max
6.	Д10 – Датчик температуры дымовых газов – При превышении граничного значения D10_max
7.	А1 – Внешняя авария – При получении сигнала внешняя авария от БУ БМК или других средств диспетчеризации, 
		при размыкании контакта Внешняя авария.

(D1!=0)|(D2!=0)|(D3>D3_max)|(D4!=0)|(D6>D6_max)|(D10>D10_max)|(D10<D10_min)|(A1!=0) 
*/
if ((sensors.D1 != 0)||(sensors.D2 != 0)||(sensors.D3 > temperatures.D3_max)||(sensors.D4 != 0)||(sensors.D10<temperatures.D10_min)
		||(sensors.D6 > temperatures.D6_max)||(sensors.D10 > temperatures.D10_max)||(sensors.A1 != 0)) boiler = CRASH_STATE;
// ============================================================================================================================================================
 main_function_maintain();
}
// ---------------------------------------------------------------------------------------------	
// ------------- Функция обработки состояния "Ожидание"
void boiler_wait(void)
{
// ============================================================================================================================================================
// Условия перехода "Ожидание" --> "Готов к включению"
/*
Из состояния Ожидание в состояние Выключено котел может перейти в следующих случаях:
1.	Д8 – Датчик комнатный термостат – размыкание короткозамкнутого контакта
2.	ВЫКЛ – нажатие клавиши выключение и удержание ее в течении 5 сек
3.	СТОП – получение команды стоп
4.	ПП – потеря электропитания – переводите котел в состояние выключено, до момента восстановления  эл. питания.
*/
if ((on_off == OFF_EVENT)||(ext_event == STOP_EVENT)||(sensors.D8 != 0)) boiler = START_READY_STATE;			
// ============================================================================================================================================================	
// Условия перехода "Ожидание" --> "Самотестирование"
/*
													Н И К О Г Д А
*/
// ============================================================================================================================================================	
// Условия перехода "Ожидание" --> "Розжиг"
/*
Из состояния Ожидание в состояние Розжиг котел может перейти в следующих случаях:
Д8 – Датчик комнатный термостат – замыкание короткозамкнутого контакта.

(D8=0)
*/
if (sensors.D8 == 0) boiler = IGNITION_STATE;;		
// ============================================================================================================================================================	
// Условия перехода "Ожидание" --> "Стабилизация"
/*
													Н И К О Г Д А	
*/
// ============================================================================================================================================================	
// Условия перехода "Ожидание" --> "Рабочий"
/*
Из состояния Ожидания  в состояние Рабочий  котел переходит в следующих случаях:
1.	Д10 – температура дымовых газов выше  значения перехода в рабочий режим D10_work, но не выше граничных значений для перехода в поддержание D10_maintain  или в блокировку D10_max
2.	Д3 – температура теплоносителя опустилась ниже высчитываемого значения D3_target-D01
3.	Д6 – температура ГВС опустилась ниже высчитываемого значения D6_target-D04
4.	Д8 – комнатный термостат – нормально замкнутый контакт замкнут, в случае если функция активна. Вне зависимости от выбранной модели «Рабочий-Выключение» или «Рабочий-Поддержание»
5.	А1 – внешняя авария – нормально замкнутый контакт замкнут и не получена команда о внешней аварии.

((D10_work<=D10<D10_maintain)&(D10<D10_max)&(D8=0)&(A1=0))|(D3<D3_target-D01)|(D6<D6_target-D04) 
*/
if (((sensors.D10 >= temperatures.D10_work)&&(sensors.D10 < temperatures.D10_maintain)&&(sensors.D10 < temperatures.D10_max)&&(sensors.D8 == 0)&&(sensors.A1 == 0))
		||(sensors.D3 < temperatures.D3_target-temperatures.D01)||(sensors.D6 < temperatures.D6_target-temperatures.D04)) boiler = WORKING_STATE;
// ============================================================================================================================================================
// Условия перехода "Ожидание" --> "Поддержание"
/*
									Н И К О Г Д А	
*/
// ============================================================================================================================================================
// Условия перехода "Ожидание" --> "Ожидание"
/*
Д3,Д6,Д10
Из состояния Ожидания  в состояние Ожидание  котел переходит в следующих случаях:
1.	Д3 – температура теплоносителя  достигла значения  D3_target+D01(гистерезис).
2.	Д6 – Температура ГВС  достигла заданного значения D6_target, если выбрана функция работы только по ГВС. Если же активна и 
		функция отопления, то проверяется еще и показания Датчика Д3 на соответствие D3_target. Учитывается датчик Д8.
3.	Д8 – Датчик комнатный термостат, если активная функция комнатный термостат и выбран режим его работы – «Рабочий-Ожидание», 
		то при размыкании короткозамкнутого контакта, котел уходит в поддержание. При условии, что температура по датчику Д10
4.	Д10 – Датчик температуры дымовых газов – не ниже температуры удавшегося розжига  D10_ignition
5.	Внешняя команда – в случае получения команды от БУ БМК или другой системы диспетчеризации о принудительном переводе котла в режим поддержание горения.

(D3>=D3_target+D01)&(D6>=D6_target)&(D8=0)&(D10>=D10_ignition)
*/
if ((sensors.D3 >= temperatures.D3_target+temperatures.D01)&&(sensors.D6 >= temperatures.D6_target)&&(sensors.D8 == 0)
		&&(sensors.D10 >= temperatures.D10_ignition)) boiler = WAITING_STATE;
// =============================================================================================================================================================
// Условия перехода "Ожидание" --> "Блокировка"
/*
			Никогда
*/
// =============================================================================================================================================================
// Условия перехода "Ожидание" --> "Авария"
/*
Д1, Д2,Д3,Д4,Д6,Д10,А1
Из состояния Ожидание в состояние Авария котел переходит в следующих случаях:
1.	Д1 - датчик аварийной температуры топливоподачи – при размыкании короткозамкнутого контакта 
2.	 Д2 – датчик уровня топлива в бункере. Размыкание контакта при активной функции, после выдержки времени Т1
3.	Д3 – датчик аварийной температуры теплоносителя. Превышения температуры теплоносителя в подаче выше установленного граничного значения D3_max
4.	Д4 – Капиллярный термостат безопасности котла – При размыкании короткозамкнутого контакта
5.	Д6 – Датчик температуры ГВС – При превышении температуры ГВС установленного граничного значения D6_max
6.	Д10 – Датчик температуры дымовых газов – При превышении граничного значения D10_max
7.	А1 – Внешняя авария – При получении сигнала внешняя авария от БУ БМК или других средств диспетчеризации, при размыкании контакта Внешняя авария.

(D1!=0)|(D2!=0)|(D3>D3_max)|(D4!=0)|(D6>D6_max)|(D10>D10_max)|(D10<D10_min)|(A1!=0)
*/
if ((sensors.D1 != 0)||(sensors.D2 != 0)||(sensors.D3 > temperatures.D3_max)||(sensors.D4 != 0)||(sensors.D10<temperatures.D10_min)
		||(sensors.D6 > temperatures.D6_max)||(sensors.D10 > temperatures.D10_max)||(sensors.A1 != 0)) boiler = CRASH_STATE;
// ==============================================================================================================================================================
main_function_wait();
}
// ------------ Функция обработки состояния "Блокировка" ---------------------------------------
void boiler_block(void)
{
// ==============================================================================================================================================================	
// Условия перехода "Блокировка" --> "Готов к включению"
/*
Из состояния Блокировка котел переходит в состояние Выключено, в случае получения последовательно следующих команд:
1.	Сброс
2.	 Выкл или Стоп
*/
if ((on_off == OFF_EVENT)||(ext_event == STOP_EVENT)||(sensors.D8 != 0)) boiler = START_READY_STATE;		
// ==============================================================================================================================================================	
// Условия перехода "Блокировка" --> "Самотестирование"
// Условия перехода "Блокировка" --> "Розжиг"
// Условия перехода "Блокировка" --> "Стабилизация"
// Условия перехода "Блокировка" --> "Рабочий"
// Условия перехода "Блокировка" --> "Поддержание"
// Условия перехода "Блокировка" --> "Ожидание"
// Условия перехода "Блокировка" --> "Блокировка"
/*
									Н И К О Г Д А	
*/
// ==============================================================================================================================================================	
// Условия перехода "Блокировка" --> "Авария"
/*
Д1, Д2,Д3,Д4,Д6,Д10,А1
Из состояния Блокировка  в состояние Авария котел переходит в следующих случаях:
1.	Д1 - датчик аварийной температуры топливоподачи – при размыкании короткозамкнутого контакта 
2.	Д3 – датчик аварийной температуры теплоносителя. Превышения температуры теплоносителя в подаче выше установленного граничного значения D3_max
3.	Д4 – Капиллярный термостат безопасности котла – При размыкании короткозамкнутого контакта
4.	Д6 – Датчик температуры ГВС – При превышении температуры ГВС установленного граничного значения D6_max
5.	Д10 – Датчик температуры дымовых газов – При превышении граничного значения D10_max
6.	А1 – Внешняя авария – При получении сигнала внешняя авария от БУ БМК или других средств диспетчеризации, при размыкании контакта Внешняя авария.

(D1!=0)|(D2!=0)|(D3>D3_max)|(D4!=0)|(D6>D6_max)|(D10>D10_max)|(D10<D10_min)|(A1!=0)
*/
if ((sensors.D1 != 0)||(sensors.D2 != 0)||(sensors.D3 > temperatures.D3_max)||(sensors.D4 != 0)||(sensors.D10<temperatures.D10_min)
		||(sensors.D6 > temperatures.D6_max)||(sensors.D10 > temperatures.D10_max)||(sensors.A1 != 0)) boiler = CRASH_STATE;
// ==============================================================================================================================================================	
 main_function_block();
}
// ---------------------------------------------------------------------------------------------	
// ----------- Функция обработки состояния "Авария" --------------------------------------------
void boiler_crash(void)
{
//NumberUartConsole = 2;	
//printf("tD10max= %5.f \r\n", temperatures.D10_max);		
//printf("tD3max= %5.f \r\n", temperatures.D3_max);
//printf("tD6max= %5.f \r\n", temperatures.D6_max);
// ==============================================================================================================================================================	
// Условия перехода "Авария" --> "Готов к включению"
/*
									Н И К О Г Д А	
*/
// ==============================================================================================================================================================	
// Условия перехода "Авария" --> "Самотестирование"
/*
В случае если состояние Аварии было вызвано датчиком Д1, то после отработки алгоритма противоаварийных действий по ДАТТ(Д1).

(D1==0)&(D2==0)&(D3<D3_max)&(D4=0)&(D6<D6_max)&(D10<D10_max)&(A1=0)	
*/
if ((sensors.D1 == 0)&&(sensors.D2==0)&&(sensors.D3<temperatures.D3_max)&&(sensors.D4==0)
		&&(sensors.D6<temperatures.D6_max)&&(sensors.D10<temperatures.D10_max)&&(sensors.A1==0))	boiler = START_READY_STATE;;
// ==============================================================================================================================================================	
// Условия перехода "Авария" --> "Розжиг"
// Условия перехода "Авария" --> "Стабилизация"
// Условия перехода "Авария" --> "Рабочий"
// Условия перехода "Авария" --> "Поддержание"
// Условия перехода "Авария" --> "Ожидание"
/*
									Н И К О Г Д А		
*/	
// ==============================================================================================================================================================	
// Условия перехода "Авария" --> "Блокировка"
/*
Д2,Д3,Д4, Д10,А1		 Д2, Д3, Д4, Д6, Д10, А1
Из состояния Авария  в состояние Блокировка  котел переходит в следующих случаях:

1.	Д2 – Датчик уровня топлива в Бункере. В случае отсутствия топлива в бункере, при активной функции контроля уровня топлива. После отработки алгоритма аварии по Д2
2.	Д3 – Датчик температуры теплоносителя в подаче, при превышении граничного значения D3_max. После отработки алгоритма Аварии по Д3
3.	Д4 – Капиллярный термостат безопасности котла – при размыкании короткозамкнутого контакта. После отработки алгоритма Аварии по Д4
4.	Д6  - при срабатывании после отработки алгоритма аварии по Д6
5.	Д10 – Датчик температуры дымовых газов – при превышении граничного значения D10_max. После отработки алгоритма Аварии по Д10
6.	А1 – Внешняя авария – при размыкании контакта внешняя авария, либо при получении сигнала внешняя авария от БУ БМК и других средств диспетчеризации. 
				После отработки алгоритма Аварии по А1

(D3>D3_max)|(D4!=0)|(D6>D6_max)|(D10>D10_max) 
*/
if ((sensors.D3 > temperatures.D3_max)||(sensors.D4 != 0)||(sensors.D6 > temperatures.D6_max)
		||(sensors.D10>temperatures.D10_max)) boiler = BLOCKING_STATE;
// ==============================================================================================================================================================	
// Условия перехода "Авария" --> "Авария"
/*
									Н И К О Г Д А	
*/
// ==============================================================================================================================================================	
main_function_crash();
}
// ---------------------------------------------------------------------------------------------
/* ===================================================================================================================================== 
   =======================================  Локальные функции ========================================================================== 
   ===================================================================================================================================== */	
// --------------------- Авария по температуре топливоподачи -------------------------------	
void FuelTemperatureAlarm(void)
{}
// -----------------------------------------------------------------------------------------	
// --------------------- Низкий уровень топлива --------------------------------------------
void FuelLevelAlarm(void)
{}
// -----------------------------------------------------------------------------------------	
// --------------------- Авария по термостату безопасности котла ---------------------------
void BoilerSafetyThermostatAlarm(void)
{}	
// -----------------------------------------------------------------------------------------
// --------------------- Предупреждение по комнатному термостату ---------------------------
void RoomThermostatAlarm(void)
{}
// -----------------------------------------------------------------------------------------	
// --------------------- Авария по внешлему сигналу А1 ---------------------------
void A1Alarm(void)
{}	
// -----------------------------------------------------------------------------------------
// ------------------------- Функция тушение горелки ---------------------------------------
void ExtinguishBurner(void)
{	
}
// -----------------------------------------------------------------------------------------
void main_function_ignition(void)
{
if (last_boiler != IGNITION_STATE) 
										{
										osTimerStart(CleanTimerHandle, (uint32_t)(1000*times.P06));
										osTimerStart(AshCleanTimerHandle, (uint32_t)(1000*times.P07));
  									ignition_count = 0;
										first_ignition_count = 0;
										second_ignition_count = 0;			
										if (binout.BurnerAuger.enable != 0)	{HAL_GPIO_WritePin(binout.BurnerAuger.GPIOx,binout.BurnerAuger.GPIO_Pin, GPIO_PIN_SET);	
										osTimerStart(BurnerAugerTimerHandle, (uint32_t)(1000*times.T06));}
										}
if (ignition_count == (uint32_t)(times.D03)) 
										{
										if (binout.HopperAuger.enable != 0) {HAL_GPIO_WritePin(binout.HopperAuger.GPIOx, binout.HopperAuger.GPIO_Pin, GPIO_PIN_SET);
										osTimerStart(HopperAugerTimerHandle, (uint32_t)(1000*(times.T06 - 2*times.D03)));}	
										}
if (ignition_count == (uint32_t)(times.T06))
										{
										if (binout.Ignition.enable != 0 )	{HAL_GPIO_WritePin(binout.Ignition.GPIOx, binout.Ignition.GPIO_Pin, GPIO_PIN_SET);
										osTimerStart(IgnitionTimerHandle, (uint32_t)(1000*times.T05));}
										TIM4->CCR1= 0xFFFF; //0x18F + cnt_pwm1;	
										osTimerStart(BurnerFanTimerHandle, (uint32_t)(1000*times.T05));
										TIM4->CCR2= 0xFFFF;	
										osTimerStart(SecondaryAirFanTimerHandle, (uint32_t)(1000*times.T05));
										TIM4->CCR3= 0xFFFF;	
										osTimerStart(SuctionFanTimerHandle, (uint32_t)(1000*times.T05));
										}
if ((ignition_count > (uint32_t)(times.T06))&&(first_ignition_count<=(uint32_t)(times.T05)))
										{
										first_ignition_count++;		
										if ((first_ignition_count%(uint32_t)(times.P05)) == 0)
																						{
																						if (binout.BurnerAuger.enable != 0)	{HAL_GPIO_WritePin(binout.BurnerAuger.GPIOx,binout.BurnerAuger.GPIO_Pin, GPIO_PIN_SET);	
																						osTimerStart(BurnerAugerTimerHandle, (uint32_t)(1000*times.T07));}
																						if (binout.HopperAuger.enable != 0) {HAL_GPIO_WritePin(binout.HopperAuger.GPIOx, binout.HopperAuger.GPIO_Pin, GPIO_PIN_SET);
																						osTimerStart(HopperAugerTimerHandle, (uint32_t)(1000*times.T25));}					
																						}	
										}
										
										

										
if (first_ignition_count==(uint32_t)(times.T05+1))
										{
										if (binout.Ignition.enable != 0 )	{HAL_GPIO_WritePin(binout.Ignition.GPIOx, binout.Ignition.GPIO_Pin, GPIO_PIN_SET);
										osTimerStart(IgnitionTimerHandle, (uint32_t)(1000*times.T08));}
										TIM4->CCR1= 0xFFFF; //0x18F + cnt_pwm1;	
										osTimerStart(BurnerFanTimerHandle, (uint32_t)(1000*times.T08));
										TIM4->CCR2= 0xFFFF;	
										osTimerStart(SecondaryAirFanTimerHandle, (uint32_t)(1000*times.T08));
										TIM4->CCR3= 0xFFFF;	
										osTimerStart(SuctionFanTimerHandle, (uint32_t)(1000*times.T08));	
										}

if ((ignition_count > (uint32_t)(times.T05))&&(second_ignition_count<=(uint32_t)(times.T08)))
										{
										second_ignition_count++;		
										if ((second_ignition_count%(uint32_t)(times.P05)) == 0)
																						{
																						if (binout.BurnerAuger.enable != 0)	{HAL_GPIO_WritePin(binout.BurnerAuger.GPIOx,binout.BurnerAuger.GPIO_Pin, GPIO_PIN_SET);	
																						osTimerStart(BurnerAugerTimerHandle, (uint32_t)(1000*times.T10));}
																						if (binout.HopperAuger.enable != 0) {HAL_GPIO_WritePin(binout.HopperAuger.GPIOx, binout.HopperAuger.GPIO_Pin, GPIO_PIN_SET);
																						osTimerStart(HopperAugerTimerHandle, (uint32_t)(1000*times.T09));}					
																						}	
										}
if (second_ignition_count>(uint32_t)(times.T08))
										{
											boiler = START_READY_STATE;
										}										
ignition_count++;
}
// -----------------------------------------------------------------------------------------
void main_function_stabilization(void)
{
if (last_boiler != STABILIZATION_STATE){
																				osTimerStart(CleanTimerHandle, (uint32_t)(1000*times.P06));
																				osTimerStart(AshCleanTimerHandle, (uint32_t)(1000*times.P07));
																				stabilization_count = 0;
																			 }
if (stabilization_count==1)
										{
										TIM4->CCR1= 0xFFFF; //0x18F + cnt_pwm1;	
										osTimerStart(BurnerFanTimerHandle, (uint32_t)(1000*times.T08));
										TIM4->CCR2= 0xFFFF;	
										osTimerStart(SecondaryAirFanTimerHandle, (uint32_t)(1000*times.T08));
										TIM4->CCR3= 0xFFFF;	
										osTimerStart(SuctionFanTimerHandle, (uint32_t)(1000*times.T08));	
										}

if ((stabilization_count%(uint32_t)(times.P05)) == 0)
										{
										if (binout.BurnerAuger.enable != 0)	{HAL_GPIO_WritePin(binout.BurnerAuger.GPIOx,binout.BurnerAuger.GPIO_Pin, GPIO_PIN_SET);	
										osTimerStart(BurnerAugerTimerHandle, (uint32_t)(1000*times.T10));}
										if (binout.HopperAuger.enable != 0) {HAL_GPIO_WritePin(binout.HopperAuger.GPIOx, binout.HopperAuger.GPIO_Pin, GPIO_PIN_SET);
										osTimerStart(HopperAugerTimerHandle, (uint32_t)(1000*times.T09));}					
										}	

if (stabilization_count > (uint32_t)(times.T08)) {stabilization_count = 0;}										

stabilization_count++;	
}
// -----------------------------------------------------------------------------------------
void main_function_work(void)
{
if (last_boiler != WORKING_STATE) {
																	osTimerStart(CleanTimerHandle, (uint32_t)(1000*times.P06));
																	osTimerStart(AshCleanTimerHandle, (uint32_t)(1000*times.P07));
																	work_count = 0;
																	} 

if (work_count==1)
										{
										TIM4->CCR1= 0xFFFF; //0x18F + cnt_pwm1;	
										osTimerStart(BurnerFanTimerHandle, (uint32_t)(1000*times.T08));
										TIM4->CCR2= 0xFFFF;	
										osTimerStart(SecondaryAirFanTimerHandle, (uint32_t)(1000*times.T08));
										TIM4->CCR3= 0xFFFF;	
										osTimerStart(SuctionFanTimerHandle, (uint32_t)(1000*times.T08));	
										}

if ((work_count%(uint32_t)(times.P05)) == 0)
										{
										if (binout.BurnerAuger.enable != 0)	{HAL_GPIO_WritePin(binout.BurnerAuger.GPIOx,binout.BurnerAuger.GPIO_Pin, GPIO_PIN_SET);	
										osTimerStart(BurnerAugerTimerHandle, (uint32_t)(1000*times.T10));}
										if (binout.HopperAuger.enable != 0) {HAL_GPIO_WritePin(binout.HopperAuger.GPIOx, binout.HopperAuger.GPIO_Pin, GPIO_PIN_SET);
										osTimerStart(HopperAugerTimerHandle, (uint32_t)(1000*times.T09));}					
										}	

if (work_count > (uint32_t)(times.T08)) {work_count = 0;}		
	
work_count++;	
}
// -----------------------------------------------------------------------------------------	
void main_function_maintain(void)
{
if (last_boiler != MAINTAINING_STATE) {
																			osTimerStart(CleanTimerHandle, (uint32_t)(1000*times.P06));
																			osTimerStart(AshCleanTimerHandle, (uint32_t)(1000*times.P07));
																			maintain_count = 0;
																			}	

if (maintain_count==1)
										{
										TIM4->CCR1= 0xFFFF; //0x18F + cnt_pwm1;	
										osTimerStart(BurnerFanTimerHandle, (uint32_t)(1000*times.T08));
										TIM4->CCR2= 0xFFFF;	
										osTimerStart(SecondaryAirFanTimerHandle, (uint32_t)(1000*times.T08));
										TIM4->CCR3= 0xFFFF;	
										osTimerStart(SuctionFanTimerHandle, (uint32_t)(1000*times.T08));	
										}

if ((maintain_count%(uint32_t)(times.P05)) == 0)
										{
										if (binout.BurnerAuger.enable != 0)	{HAL_GPIO_WritePin(binout.BurnerAuger.GPIOx,binout.BurnerAuger.GPIO_Pin, GPIO_PIN_SET);	
										osTimerStart(BurnerAugerTimerHandle, (uint32_t)(1000*times.T10));}
										if (binout.HopperAuger.enable != 0) {HAL_GPIO_WritePin(binout.HopperAuger.GPIOx, binout.HopperAuger.GPIO_Pin, GPIO_PIN_SET);
										osTimerStart(HopperAugerTimerHandle, (uint32_t)(1000*times.T09));}					
										}	

if (maintain_count > (uint32_t)(times.T08)) {maintain_count = 0;}		
	

maintain_count++;	
}
// -----------------------------------------------------------------------------------------	
void main_function_wait(void)
{
if (last_boiler != WAITING_STATE) {
																	osTimerStart(CleanTimerHandle, (uint32_t)(1000*times.P06));
																	osTimerStart(AshCleanTimerHandle, (uint32_t)(1000*times.P07));
																	wait_count = 0;
																	}

if (wait_count==1)
										{
										TIM4->CCR1= 0xFFFF; //0x18F + cnt_pwm1;	
										osTimerStart(BurnerFanTimerHandle, (uint32_t)(1000*times.T08));
										TIM4->CCR2= 0xFFFF;	
										osTimerStart(SecondaryAirFanTimerHandle, (uint32_t)(1000*times.T08));
										TIM4->CCR3= 0xFFFF;	
										osTimerStart(SuctionFanTimerHandle, (uint32_t)(1000*times.T08));	
										}

if ((wait_count%(uint32_t)(times.P05)) == 0)
										{
										if (binout.BurnerAuger.enable != 0)	{HAL_GPIO_WritePin(binout.BurnerAuger.GPIOx,binout.BurnerAuger.GPIO_Pin, GPIO_PIN_SET);	
										osTimerStart(BurnerAugerTimerHandle, (uint32_t)(1000*times.T10));}
										if (binout.HopperAuger.enable != 0) {HAL_GPIO_WritePin(binout.HopperAuger.GPIOx, binout.HopperAuger.GPIO_Pin, GPIO_PIN_SET);
										osTimerStart(HopperAugerTimerHandle, (uint32_t)(1000*times.T09));}					
										}	

if (wait_count > (uint32_t)(times.T08)) {wait_count = 0;}		
	

wait_count++;	
}
// -----------------------------------------------------------------------------------------	
void main_function_block(void)
{
if (last_boiler != BLOCKING_STATE){block_count = 0;} 	
block_count++;
}
// -----------------------------------------------------------------------------------------	
void main_function_crash(void)
{
if (last_boiler != CRASH_STATE){crash_count = 0;} 	
crash_count++;	
}
// -----------------------------------------------------------------------------------------
void AllTimersStop(void)
{
osTimerStop(BurnerAugerTimerHandle);
osTimerStop(HopperAugerTimerHandle);
osTimerStop(AutoCleanTimerHandle);
osTimerStop(AshRemoveTimerHandle);
osTimerStop(HotWaterPumpTimerHandle);
osTimerStop(Aux1TimerHandle);
osTimerStop(CirclePumpTimerHandle);
osTimerStop(IgnitionTimerHandle);
osTimerStop(BurnerFanTimerHandle);
osTimerStop(SecondaryAirFanTimerHandle);
osTimerStop(SuctionFanTimerHandle);
}
void All_Off(void)
{
if (binout.HopperAuger.enable != 0) HAL_GPIO_WritePin(binout.HopperAuger.GPIOx, binout.HopperAuger.GPIO_Pin, GPIO_PIN_RESET);
if (binout.BurnerAuger.enable != 0)	HAL_GPIO_WritePin(binout.BurnerAuger.GPIOx, binout.BurnerAuger.GPIO_Pin, GPIO_PIN_RESET);
if (binout.Aux1.enable != 0) HAL_GPIO_WritePin(binout.Aux1.GPIOx, binout.Aux1.GPIO_Pin, GPIO_PIN_RESET);													
if (binout.HotWaterPump.enable != 0) HAL_GPIO_WritePin(binout.HotWaterPump.GPIOx, binout.HotWaterPump.GPIO_Pin, GPIO_PIN_RESET);
if (binout.Ignition.enable != 0 )	HAL_GPIO_WritePin(binout.Ignition.GPIOx, binout.Ignition.GPIO_Pin, GPIO_PIN_RESET);
//if (binout.AutoClean.enable != 0)	HAL_GPIO_WritePin(binout.AutoClean.GPIOx, binout.AutoClean.GPIO_Pin, GPIO_PIN_RESET);
//if (binout.AshRemove.enable != 0)	HAL_GPIO_WritePin(binout.AshRemove.GPIOx, binout.AshRemove.GPIO_Pin, GPIO_PIN_RESET);		
if (binout.CirclePump.enable != 0) HAL_GPIO_WritePin(binout.CirclePump.GPIOx, binout.CirclePump.GPIO_Pin, GPIO_PIN_RESET);
//if (binout.FireSafetyValve.enable != 0)	HAL_GPIO_WritePin(binout.FireSafetyValve.GPIOx, binout.FireSafetyValve.GPIO_Pin, GPIO_PIN_RESET);
//if (binout.AlarmDry.enable != 0)	HAL_GPIO_WritePin(binout.AlarmDry.GPIOx, binout.AlarmDry.GPIO_Pin, GPIO_PIN_RESET);
TIM4->CCR1= 0x0;	
TIM4->CCR2= 0x0;
TIM4->CCR3= 0x0;		
}
// ---------------------------------------------------------------------------------------------------------------------------------
//******************************************************************************
// ENF OF FILE
//******************************************************************************

	
